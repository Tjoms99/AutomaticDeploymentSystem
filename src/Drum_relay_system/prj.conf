## CMakeLists.txt
```
# SPDX-License-Identifier: Apache-2.0

cmake_minimum_required(VERSION 3.20.0)
find_package(Zephyr REQUIRED HINTS $ENV{ZEPHYR_BASE})
project(peripheral)

target_sources(app PRIVATE
  src/rs485/uart.c 
  src/rs485/rs485.c 
  src/main.c
  src/gpio/leds.c
  src/gpio/battery.c
  src/bluetooth/bluetooth.c
)
```

## prj.conf
```kconfig
#Bluetooth
CONFIG_BT=y
CONFIG_BT_CENTRAL=y
CONFIG_BT_SMP=y
CONFIG_BT_GATT_CLIENT=y
CONFIG_BT_L2CAP_TX_BUF_COUNT=64

#USB / Termial
CONFIG_SERIAL=y
CONFIG_LOG=y
CONFIG_USB_DEVICE_PRODUCT="Winch Control System"
CONFIG_USB_DEVICE_PID=0x4321
CONFIG_USB_DEVICE_VID=0x1234

#Peripherials 
CONFIG_GPIO=y
CONFIG_UART_ASYNC_API=y
CONFIG_UART_0_INTERRUPT_DRIVEN=y
CONFIG_ADC=y
```

## src/main.c
```c
#include "gpio/leds.h"
#include "bluetooth/bluetooth.h"
#include "rs485/rs485.h"
#include "gpio/battery.h"

#include <zephyr/kernel.h>
#include <zephyr/sys/printk.h>
#include <zephyr/drivers/adc.h>
#include <zephyr/logging/log.h>
LOG_MODULE_REGISTER(main, LOG_LEVEL_INF);

#define SLEEP_TIME_MS 2000

int main(void)
{
	int ret = 0;
	k_msleep(SLEEP_TIME_MS * 2); // Gives time for the terminal to connect to catch LOG's

	ret |= leds_init();
	ret |= battery_init();
	ret |= rs485_init();
	ret |= bluetooth_init();
	// ret |= leds_set_blue(1);

	ret |= battery_charge_start();

	if (ret)
	{
		LOG_ERR("Failed to initialize");
	}
	else
	{
		LOG_INF("Initialized");
	}

	while (1)
	{
		// k_msleep(SLEEP_TIME_MS);
		__WFE();
		__WFI();
	}

	return 0;
}
```
