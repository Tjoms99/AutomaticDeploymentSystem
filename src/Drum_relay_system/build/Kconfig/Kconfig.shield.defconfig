## src/Drum_relay_system/build/Kconfig/Kconfig.shield.defconfig
```kconfig
osource "f:/automaticdeploymentsystem/src/drum_relay_system/boards/shields/*/Kconfig.defconfig"
osource "C:/ncs/v2.4.0/nrf/boards/shields/*/Kconfig.defconfig"
```

## src/Drum_relay_system_1/build/Kconfig/Kconfig.shield
```kconfig
osource "f:/automaticdeploymentsystem/src/drum_relay_system/boards/shields/*/Kconfig.shield"
osource "C:/ncs/v2.4.0/nrf/boards/shields/*/Kconfig.shield"
```
